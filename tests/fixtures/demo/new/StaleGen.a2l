ASAP2_VERSION 1 71
/begin PROJECT StaleGen ""
/begin MODULE CAL ""
/begin CHARACTERISTIC K_Bias "output bias" VALUE 0x9000 __UBYTE_Z 0 IDENTICAL 0 255 /end CHARACTERISTIC
/begin CHARACTERISTIC K_Limit "output clamp limit" VALUE 0x9010 __UBYTE_Z 0 IDENTICAL 0 255 /end CHARACTERISTIC
/end MODULE
/end PROJECT
