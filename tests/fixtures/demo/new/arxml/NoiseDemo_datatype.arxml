AUTOSAR XML (schema 4.0)
package /DataTypes
  impl type Velocity_T
