AUTOSAR XML (schema 4.0)
package /ComponentTypes
  application sw component type Controller
    provide port Out1
