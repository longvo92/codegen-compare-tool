AUTOSAR XML (schema 4.0)
package /Powertrain
  application sw component type StaleGen
    require port In: required-interface=If_In
    provide port Status: provided-interface=If_Status
