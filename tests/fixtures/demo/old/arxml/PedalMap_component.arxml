AUTOSAR XML (schema 4.0)
package /Powertrain
  application sw component type PedalMap
    require port Raw: required-interface=If_Raw
