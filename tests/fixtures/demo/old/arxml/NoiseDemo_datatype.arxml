AUTOSAR XML (schema 4.0)
package /DataTypes
  impl type Speed_T
